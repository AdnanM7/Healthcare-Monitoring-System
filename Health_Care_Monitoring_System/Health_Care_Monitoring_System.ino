#define USE_ARDUINO_INTERRUPTS false
#include <PulseSensorPlayground.h>
#include <Adafruit_GFX.h>
#include <Adafruit_SSD1306.h>
#include <Wire.h>
#include "MAX30105.h"
#include "spo2_algorithm.h"
#include <Adafruit_MLX90614.h>
#include "MQ135.h"
#define RLOAD 22.0
#include "SPI.h"
#include "SD.h"
#include "FS.h"
#define SD_CS 5
//#include <MPU6050_tockn.h>

String ecgValues;
String heartbeat;
String spo2Values;
String bodyTemp;
String airQuali;
String ambiTemp;

const int PULSE_INPUT = A4;
const int THRESHOLD = 550;   // Adjust this number to avoid noise when idle
byte samplesUntilReport;
const byte SAMPLES_PER_SERIAL_SAMPLE = 10;
PulseSensorPlayground pulseSensor;


int botonState = 0;
int ECGbutton = 15;

#define SCREEN_WIDTH 128 // OLED display width, in pixels
#define SCREEN_HEIGHT 64
#define OLED_RESET -1
Adafruit_SSD1306 display(SCREEN_WIDTH, SCREEN_HEIGHT, &Wire, OLED_RESET);
Adafruit_MLX90614 mlx = Adafruit_MLX90614();
MAX30105 particleSensor;
MQ135 gasSensor = MQ135(A3);
int val;
int tone = 12;


#define MAX_BRIGHTNESS 255

#if defined(__AVR_ATmega328P__) || defined(__AVR_ATmega168__)
//Arduino Uno doesn't have enough SRAM to store 100 samples of IR led data and red led data in 32-bit format
//To solve this problem, 16-bit MSB of the sampled data will be truncated. Samples become 16-bit data.
uint16_t irBuffer[100]; //infrared LED sensor data
uint16_t redBuffer[100];  //red LED sensor data
#else
uint32_t irBuffer[100]; //infrared LED sensor data
uint32_t redBuffer[100];  //red LED sensor data
#endif

int32_t bufferLength; //data length
int32_t spo2; //SPO2 value
int8_t validSPO2; //indicator to show if the SPO2 calculation is valid
int32_t heartRate; //heart rate value
int8_t validHeartRate;
int xx=40;
int yy=0;
int tt=0;
const unsigned char PROGMEM frame0 [] = {0x00, 0x00, 0x00, 0x00, 0x00, 0x00, 0x00, 0x00, 0x00, 0x00, 0x00, 0x00, 0x00,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 0x00, 0x00};

const unsigned char PROGMEM frame1 [] = {0x00, 0x00, 0x00, 0x00, 0x00, 0x00, 0x00, 0x00, 0x00, 0x00, 0x00, 0x00, 0x00,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 0x00, 0x00};

const unsigned char PROGMEM frame2 [] = {0x00, 0x00, 0x00, 0x00, 0x00, 0x00, 0x00, 0x00, 0x00, 0x00, 0x00, 0x00, 0x00,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 0x00, 0x00};

const unsigned char PROGMEM frame3 [] = {0x00, 0x00, 0x00, 0x00, 0x00, 0x00, 0x00, 0x00, 0x00, 0x00, 0x00, 0x00, 0x00,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 0x00, 0x00};

const unsigned char PROGMEM frame4 [] = {0x00, 0x00, 0x00, 0x00, 0x00, 0x00, 0x00, 0x00, 0x00, 0x00, 0x00, 0x00, 0x00,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 0x00, 0x00};

const unsigned char PROGMEM frame5 [] = {0x00, 0x00, 0x00, 0x00, 0x00, 0x00, 0x00, 0x00, 0x00, 0x00, 0x00, 0x00, 0x00,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 0x00, 0x00};

const unsigned char PROGMEM frame6 [] = {0x00, 0x00, 0x00, 0x00, 0x00, 0x00, 0x00, 0x00, 0x00, 0x00, 0x00, 0x00, 0x00,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 0x00, 0x00};

const unsigned char PROGMEM frame7 [] = {0x00, 0x00, 0x00, 0x00, 0x00, 0x00, 0x00, 0x00, 0x00, 0x00, 0x00, 0x00, 0x00,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 0x00, 0x00};

const unsigned char PROGMEM frame8 [] = {0x00, 0x00, 0x00, 0x00, 0x00, 0x00, 0x00, 0x00, 0x00, 0x00, 0x00, 0x00, 0x00,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 0x00, 0x00};

const unsigned char PROGMEM frame9 [] = {0x00, 0x00, 0x00, 0x00, 0x00, 0x00, 0x00, 0x00, 0x00, 0x00, 0x00, 0x00, 0x00,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 0x00, 0x00};

const unsigned char PROGMEM frame10 [] = {0x00, 0x00, 0x00, 0x00, 0x00, 0x00, 0x00, 0x00, 0x00, 0x00, 0x00, 0x00, 0x00,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 0x00, 0x00};

const unsigned char PROGMEM frame11 [] = {0x00, 0x00, 0x00, 0x00, 0x00, 0x00, 0x00, 0x00, 0x00, 0x00, 0x00, 0x00, 0x00,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 0x00, 0x00};

const unsigned char PROGMEM frame12 [] = {0x00, 0x00, 0x00, 0x00, 0x00, 0x00, 0x00, 0x00, 0x00, 0x00, 0x00, 0x00, 0x00,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 0x00, 0x00};

const unsigned char PROGMEM frame13 [] = {0x00, 0x00, 0x00, 0x00, 0x00, 0x00, 0x00, 0x00, 0x00, 0x00, 0x00, 0x00, 0x00,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 0x00, 0x00};

const unsigned char PROGMEM frame14 [] = {0x00, 0x00, 0x00, 0x00, 0x00, 0x00, 0x00, 0x00, 0x00, 0x00, 0x00, 0x00, 0x00,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 0x00, 0x00};

const unsigned char PROGMEM frame15 [] = {0x00, 0x00, 0x00, 0x00, 0x00, 0x00, 0x00, 0x00, 0x00, 0x00, 0x00, 0x00, 0x00,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 0x00, 0x00};

const unsigned char PROGMEM frame16 [] = {0x00, 0x00, 0x00, 0x00, 0x00, 0x00, 0x00, 0x00, 0x00, 0x00, 0x00, 0x00, 0x00,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 0x00, 0x00};

const unsigned char PROGMEM frame17 [] = {0x00, 0x00, 0x00, 0x00, 0x00, 0x00, 0x00, 0x00, 0x00, 0x00, 0x00, 0x00, 0x00,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 0x00, 0x00};

const unsigned char PROGMEM frame18 [] = {0x00, 0x00, 0x00, 0x00, 0x00, 0x00, 0x00, 0x00, 0x00, 0x00, 0x00, 0x00, 0x00,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 0x00, 0x00};

const unsigned char PROGMEM frame19 [] = {0x00, 0x00, 0x00, 0x00, 0x00, 0x00, 0x00, 0x00, 0x00, 0x00, 0x00, 0x00, 0x00,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 0x00, 0x00};

const unsigned char PROGMEM frame20 [] = {0x00, 0x00, 0x00, 0x00, 0x00, 0x00, 0x00, 0x00, 0x00, 0x00, 0x00, 0x00, 0x00,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 0x00, 0x00};

const unsigned char PROGMEM frame21 [] = {0x00, 0x00, 0x00, 0x00, 0x00, 0x00, 0x00, 0x00, 0x00, 0x00, 0x00, 0x00, 0x00,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 0x00, 0x00};

const unsigned char PROGMEM frame22 [] = {0x00, 0x00, 0x00, 0x00, 0x00, 0x00, 0x00, 0x00, 0x00, 0x00, 0x00, 0x00, 0x00,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 0x00, 0x00};

const unsigned char PROGMEM frame23 [] = {0x00, 0x00, 0x00, 0x00, 0x00, 0x00, 0x00, 0x00, 0x00, 0x00, 0x00, 0x00, 0x00,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 0x00, 0x00};

const unsigned char PROGMEM frame24 [] = {0x00, 0x00, 0x00, 0x00, 0x00, 0x00, 0x00, 0x00, 0x00, 0x00, 0x00, 0x00, 0x00,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 0x00, 0x00};

const unsigned char PROGMEM frame25 [] = {0x00, 0x00, 0x00, 0x00, 0x00, 0x00, 0x00, 0x00, 0x00, 0x00, 0x00, 0x00, 0x00,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 0x00, 0x00};

const unsigned char PROGMEM frame26 [] = {0x00, 0x00, 0x00, 0x00, 0x00, 0x00, 0x00, 0x00, 0x00, 0x00, 0x00, 0x00, 0x00,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 0x00, 0x00};

const unsigned char PROGMEM frame27 [] = {0x00, 0x00, 0x00, 0x00, 0x00, 0x00, 0x00, 0x00, 0x00, 0x00, 0x00, 0x00, 0x00,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 0x00, 0x00};



//Very IMP for SD card Not to change 
void writeFile(fs::FS &fs, const char * path, const char * message) {
  Serial.printf("Writing file: %s\n", path);
  File file = fs.open(path, FILE_WRITE);
  if(!file) {
    Serial.println("Failed to open file for writing");
    return;
  }
  if(file.print(message)) {
    Serial.println("File written");
  } else {
    Serial.println("Write failed");
  }
  file.close();
}
// Append data to the SD card (DON'T MODIFY THIS FUNCTION)
void appendFile(fs::FS &fs, const char * path, const char * message) {
  Serial.printf("Appending to file: %s\n", path);
  File file = fs.open(path, FILE_APPEND);
  if(!file) {
    Serial.println("Failed to open file for appending");
    return;
  }
  if(file.print(message)) {
    Serial.println("Message appended");
  } else {
    Serial.println("Append failed");
  }
  file.close();
}

void setup() {
  Serial.begin(9600);
  
  
  SD.begin(SD_CS);
  //pinMode(sensorPin, INPUT);
  display.begin(SSD1306_SWITCHCAPVCC, 0x3C);
  display.clearDisplay();
        //display.clearDisplay();
      display.setTextSize(2);
      display.setTextColor(WHITE);
      display.setCursor(0, 0);
      display.setTextSize(2);
      display.print("    CME");
      display.setTextSize(1);
      display.setCursor(0, 17);
      display.print("      Health Care");
      display.setCursor(0, 27);
      display.print("   Monitoring System");
      display.setTextSize(2);
      display.print("    ");
      //display.display();
  display.display();
  delay(2000);
  pinMode(tone, OUTPUT);
  byte ledBrightness = 60; //Options: 0=Off to 255=50mA
  byte sampleAverage = 4; //Options: 1, 2, 4, 8, 16, 32
  byte ledMode = 2; //Options: 1 = Red only, 2 = Red + IR, 3 = Red + IR + Green
  byte sampleRate = 100; //Options: 50, 100, 200, 400, 800, 1000, 1600, 3200
  int pulseWidth = 411; //Options: 69, 118, 215, 411
  int adcRange = 4096; //Options: 2048, 4096, 8192, 16384
  particleSensor.begin(Wire, I2C_SPEED_FAST);
  particleSensor.setup(ledBrightness, sampleAverage, ledMode, sampleRate, pulseWidth, adcRange);
  pinMode(41, INPUT); // Setup for leads off detection LO +
  pinMode(40, INPUT);

  pulseSensor.analogInput(PULSE_INPUT);

  pulseSensor.setThreshold(THRESHOLD);

  // Skip the first SAMPLES_PER_SERIAL_SAMPLE in the loop().
  samplesUntilReport = SAMPLES_PER_SERIAL_SAMPLE;

  // Now that everything is ready, start reading the PulseSensor signal.
   if (pulseSensor.begin()) {
    Serial.println("We created a pulseSensor Object !");  //This prints one time at Arduino power-up,  or on Arduino reset.  
  }



  pinMode(0, INPUT_PULLUP);
  uint8_t cardType = SD.cardType();

  
  File bfile = SD.open("/ecg.txt");
  if(!bfile) {
    writeFile(SD, "/ecg.txt", "ESP32 and SD Card \r\n");
  }
  File afile = SD.open("/air_quality.txt");
   if(!afile) {
    writeFile(SD, "/air_quality.txt", "ESP32 and SD Card \r\n");
  }

  File cfile = SD.open("/body_temp.txt");
  if(!cfile) {
    writeFile(SD, "/body_temp.txt", "ESP32 and SD Card \r\n");
  }

  File dfile = SD.open("/heart_rate.txt");
  if(!dfile) {
    writeFile(SD, "/heart_rate.txt", "ESP32 and SD Card \r\n");
  }

  File efile = SD.open("/spo2.txt");
  if(!efile){
    writeFile(SD, "/spo2.txt", "ESP32 and SD Card \r\n");
  }

  File ffile = SD.open("/ambient_Temp.txt");
  if(!ffile){
    writeFile(SD, "/ambient_Temp.txt", "ESP32 and SD Card \r\n");
  }


}


void loop() {

  int myBPM = pulseSensor.getBeatsPerMinute();
  float ppm = gasSensor.getPPM();

  
  if (digitalRead(4) == 0) {
    botonState = (botonState + 1) % 5;
    delay(200);
  }
  switch (botonState) {
    case 0:
          (pulseSensor.sawNewSample()) ;
      if (--samplesUntilReport == (byte) 0) {
        samplesUntilReport = SAMPLES_PER_SERIAL_SAMPLE;

        pulseSensor.outputSample();
        if (pulseSensor.sawStartOfBeat()) {
          //Serial.println("A heartBeat Happened ");
          //Serial.print("BPM: ");
          //Serial.println(myBPM);
          display.clearDisplay();
          display.setTextSize(2);
          display.setTextColor(WHITE);
          display.setCursor(0,0);
          display.print("Heart Rate");
          display.setCursor(0, 20);
          display.print("BPM:  ");
          display.setCursor(0, 40);
          display.print(myBPM);
          display.display();
          pulseSensor.outputBeat();
          delay(200);
          heartbeat =  String(myBPM) + "\n";
          appendFile(SD, "/heart_rate.txt", heartbeat.c_str());
        }
      }
      break;

      case 1:
              //body temperature display on oled display
         display.clearDisplay();
        display.setTextSize(2);                    
        display.setTextColor(WHITE);             
        display.setCursor(0,0);                
        display.println("BODY TEMP:"); 
 
  
        display.setTextSize(2);
        display.setCursor(0,20);
        display.println(mlx.readObjectTempC(),1);
        display.setCursor(0,40);
        display.println(mlx.readObjectTempF());
        
  
        display.setCursor(80,20);
        display.println("C"); 
        display.setCursor(80,40);
        display.println("F");
        display.display();
        bodyTemp = String(mlx.readObjectTempF()) + "\n";
        appendFile(SD, "/body_temp.txt", bodyTemp.c_str());
        if (mlx.readObjectTempC() >= 100){
          delay(1000);
          digitalWrite (tone, HIGH);
//          digitalWrite(LED_BUILTIN, HIGH);
          delay(5000);
          digitalWrite (tone, LOW);
//          digitalWrite(LED_BUILTIN, LOW);
        }
      
      break;

      case 2:
     
      //Serial.print ("ppm: ");
      //Serial.println (ppm);
      display.clearDisplay();
      display.setTextSize(2);
      display.setTextColor(WHITE);
      display.setCursor(0,0);
      display.println("Air Quali:");
      display.setCursor(0,20);
      display.println("PPM:");
      display.setTextSize(2);
      display.setCursor(45,20);
      display.println(ppm);
      display.display();
      display.clearDisplay();
      airQuali = String(ppm) + "\n";
      appendFile(SD, "/air_quality.txt", airQuali.c_str());
      delay(1000);
      
      break;

      case 3:
            
      display.clearDisplay();
      display.setTextSize(2);
      display.setTextColor(WHITE);
      display.setCursor(0,0);
      display.println("Ambient");
      display.setCursor(0,20);
      display.println("Tempe:");
      display.setCursor(0,40);
      display.println(mlx.readAmbientTempC());
      display.setTextSize(2);
      display.setCursor(60,40);
      display.println("C");
      display.display();
      display.clearDisplay();
      ambiTemp = String(mlx.readAmbientTempC()) + "\n";
      appendFile(SD, "/ambient_Temp.txt", ambiTemp.c_str());
      delay(500);
      break;

      

      case 4:
      bufferLength = 100; //buffer length of 100 stores 4 seconds of samples running at 25sps
  
    maxim_heart_rate_and_oxygen_saturation(irBuffer, bufferLength, redBuffer, &spo2, &validSPO2, &heartRate, &validHeartRate);

  //Continuously taking samples from MAX30102.  Heart rate and SpO2 are calculated every 1 second
    while (1)
    { 
     //dumping the first 25 sets of samples in the memory and shift the last 75 sets of samples to the top
      for (byte i = 25; i < 100; i++)
      {
        redBuffer[i - 25] = redBuffer[i];
        irBuffer[i - 25] = irBuffer[i];
      }

     //take 25 sets of samples before calculating the heart rate.
      for (byte i = 75; i < 100; i++)
      {
        while (particleSensor.available() == false) //do we have new data?
          particleSensor.check(); //Check the sensor for new data

        //digitalWrite(readLED, !digitalRead(readLED)); //Blink onboard LED with every data read

        redBuffer[i] = particleSensor.getRed();
        irBuffer[i] = particleSensor.getIR();
        particleSensor.nextSample(); //We're finished with this sample so move to next sample

  
        //display spo2 levels on oled display
        display.clearDisplay();  
        display.setTextSize(2);
        display.setTextColor(WHITE);
        display.setCursor(0,0);
        display.println("SpO2");
        display.setTextSize(2);
        display.setCursor(0,20);
        display.println(spo2);
        display.setCursor(0,20);
        display.print("    %");
        display.display();
        spo2Values = String(spo2) + "\n";
        appendFile(SD, "/spo2.txt", spo2Values.c_str());

        //if body temperature of human passes 100*F notify danger

      

  
}
      maxim_heart_rate_and_oxygen_saturation(irBuffer, bufferLength, redBuffer, &spo2, &validSPO2, &heartRate, &validHeartRate);
          
        
        }

      break;

  }
  
  
  if (digitalRead(15) == 0) {
    ECGbutton = (ECGbutton + 1) % 5;
    delay(200);
  }
  switch (ECGbutton) {
    case 1:
    if((digitalRead(40) == 1)||(digitalRead(41) == 1)){
    Serial.println('!');
    //ESP_BT.println('!');
  }
  else{
    // send the value of analog input 0 to serial:
    Serial.println(analogRead(A0));
    ecgValues = String(analogRead(A0)) + "\n";
    appendFile(SD, "/ecg.txt", ecgValues.c_str());
    
display.clearDisplay();
display.drawBitmap(xx, yy,frame0,48,48, 1);
display.display();
delay(tt);

display.clearDisplay();
display.drawBitmap(xx, yy,frame1,48,48, 1);
display.display();
delay(tt);

display.clearDisplay();
display.drawBitmap(xx, yy,frame2,48,48, 1);
display.display();
delay(tt);

display.clearDisplay();
display.drawBitmap(xx, yy,frame3,48,48, 1);
display.display();
delay(tt);

display.clearDisplay();
display.drawBitmap(xx, yy,frame4,48,48, 1);
display.display();
delay(tt);

display.clearDisplay();
display.drawBitmap(xx, yy,frame5,48,48, 1);
display.display();
delay(tt);

display.clearDisplay();
display.drawBitmap(xx, yy,frame6,48,48, 1);
display.display();
delay(tt);

display.clearDisplay();
display.drawBitmap(xx, yy,frame7,48,48, 1);
display.display();
delay(tt);

display.clearDisplay();
display.drawBitmap(xx, yy,frame8,48,48, 1);
display.display();
delay(tt);

display.clearDisplay();
display.drawBitmap(xx, yy,frame9,48,48, 1);
display.display();
delay(tt);

display.clearDisplay();
display.drawBitmap(xx, yy,frame10,48,48, 1);
display.display();
delay(tt);

display.clearDisplay();
display.drawBitmap(xx, yy,frame11,48,48, 1);
display.display();
delay(tt);

display.clearDisplay();
display.drawBitmap(xx, yy,frame12,48,48, 1);
display.display();
delay(tt);

display.clearDisplay();
display.drawBitmap(xx, yy,frame13,48,48, 1);
display.display();
delay(tt);

display.clearDisplay();
display.drawBitmap(xx, yy,frame14,48,48, 1);
display.display();
delay(tt);

display.clearDisplay();
display.drawBitmap(xx, yy,frame15,48,48, 1);
display.display();
delay(tt);

display.clearDisplay();
display.drawBitmap(xx, yy,frame16,48,48, 1);
display.display();
delay(tt);

display.clearDisplay();
display.drawBitmap(xx, yy,frame17,48,48, 1);
display.display();
delay(tt);

display.clearDisplay();
display.drawBitmap(xx, yy,frame18,48,48, 1);
display.display();
delay(tt);

display.clearDisplay();
display.drawBitmap(xx, yy,frame19,48,48, 1);
display.display();
delay(tt);

display.clearDisplay();
display.drawBitmap(xx, yy,frame20,48,48, 1);
display.display();
delay(tt);

display.clearDisplay();
display.drawBitmap(xx, yy,frame21,48,48, 1);
display.display();
delay(tt);

display.clearDisplay();
display.drawBitmap(xx, yy,frame22,48,48, 1);
display.display();
delay(tt);

display.clearDisplay();
display.drawBitmap(xx, yy,frame23,48,48, 1);
display.display();
delay(tt);

display.clearDisplay();
display.drawBitmap(xx, yy,frame24,48,48, 1);
display.display();
delay(tt);

display.clearDisplay();
display.drawBitmap(xx, yy,frame25,48,48, 1);
display.display();
delay(tt);

display.clearDisplay();
display.drawBitmap(xx, yy,frame26,48,48, 1);
display.display();
delay(tt);

display.clearDisplay();
display.drawBitmap(xx, yy,frame27,48,48, 1);
display.display();
delay(tt);

    //Do the same for blutooth
    /*if(BT_cnx){
      ESP_BT.print('E'); //make the app Blutooth Graphics (https://play.google.com/store/apps/details?id=com.emrctn.BluetoothGraphics&hl=en_US) work (as specified by the app)
      ESP_BT.println(analogRead(A0));
    } */
    
  }
  break;
  }
  

  //delay(300);
}
